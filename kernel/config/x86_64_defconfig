## kernel/config/x86_64_defconfig
```kconfig
CONFIG_64BIT=y
CONFIG_SMP=y
CONFIG_PREEMPT=y
CONFIG_BLK_DEV_INITRD=y
CONFIG_EXT4_FS=y
CONFIG_VT=y
CONFIG_DRM=y
CONFIG_DRM_AMDGPU=y
CONFIG_DRM_I915=y
CONFIG_NET=y
CONFIG_BINFMT_ELF=y
```
